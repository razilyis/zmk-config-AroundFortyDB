## config/boards/shields/around_forty_db/Kconfig.defconfig
```kconfig
if SHIELD_AROUND_FORTY_DB_RIGHT

config ZMK_KEYBOARD_NAME
    string
    default "AroundFortyDB_R"

config ZMK_SPLIT
    default y

config ZMK_SPLIT_ROLE_CENTRAL
    default y

endif

if SHIELD_AROUND_FORTY_DB_LEFT
config ZMK_KEYBOARD_NAME
    default "AroundFortyDB_L"

config ZMK_SPLIT
    default y

endif
```

## config/boards/shields/around_forty_db/Kconfig.shield
```kconfig
config SHIELD_AROUND_FORTY_DB_RIGHT
    def_bool $(shields_list_contains,around_forty_db_right)

config SHIELD_AROUND_FORTY_DB_LEFT
    def_bool $(shields_list_contains,around_forty_db_left) 
```
